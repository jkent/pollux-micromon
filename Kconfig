## defconfig
```kconfig
# CONFIG_BAREMETAL_BOOT_SOURCE_RAM is not set
CONFIG_BAREMETAL_BOOT_SOURCE_UART=y
CONFIG_BAREMETAL_RAM_SIZE_16=y
# CONFIG_BAREMETAL_RAM_SIZE_32 is not set
# CONFIG_BAREMETAL_RAM_SIZE_64 is not set
# CONFIG_BAREMETAL_RAM_SIZE_128 is not set
CONFIG_BAREMETAL_RAM_SIZE=0x1000000

#
# Linker script options
#
CONFIG_BAREMETAL_SHADOW=y
CONFIG_BAREMETAL_RUNTIME_ADDRESS=0x00000000
# end of Linker script options

#
# Entry code options
#
# CONFIG_BAREMETAL_AUTO_RELOCATE is not set
# end of Entry code options

#
# Startup code options
#
# CONFIG_BAREMETAL_NEWLIB is not set
# CONFIG_BAREMETAL_FREERTOS is not set
CONFIG_BAREMETAL_LATCH_POWER=y
# CONFIG_BAREMETAL_STARTUP_BKPT is not set
# CONFIG_BAREMETAL_EXCEPTION is not set
# CONFIG_BAREMETAL_MMU is not set
# CONFIG_BAREMETAL_ICACHE is not set
CONFIG_BAREMETAL_PLL1_INIT_NONE=y
# CONFIG_BAREMETAL_PLL1_INIT_120 is not set
# CONFIG_BAREMETAL_DDR_INIT is not set
CONFIG_BAREMETAL_UART_NONE=y
# end of Startup code options
```
